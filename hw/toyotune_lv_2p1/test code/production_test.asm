                        .msfirst                ; Big Endian processor
                                
                        .org    0000h

DDRA:                   .block  1               ; Port A i/o config
DDRB:                   .block  1               ; Port B i/o config
WDC:                    .block  1               ; watch dog timer
TIMER3:                 .block  1               ; Timer LSB (bit0~bit2)
TIMER:                  .block  1               ; Timer MSB (bit11~bit18)
TIMERL:                 .block  1               ; Timer LSB (bit3~bit10)
SIDR_SODR:              .block  1               ; Serial Input/Output Data Register
SMRC_SIR:               .block  1               ; Serial Master Register Control
CPR0:                   .block  1               ; Timer comparison #0 MSB
CPR0L:                  .block  1               ; Timer comparison #0 LSB
CPR1:                   .block  1               ; Timer comparison #1 MSB
CPR1L:                  .block  1               ; Timer comparison #1 LSB
CPR2:                   .block  1               ; Timer comparison #2 MSB
CPR2L:                  .block  1               ; Timer comparison #2 LSB
CPR3:                   .block  1               ; Timer comparison #3 MSB
CPR3L:                  .block  1               ; Timer comparison #3 LSB
ASR0P:                  .block  1               ; ASR0 pos edge counter value MSB
ASR0PL:                 .block  1               ; ASR0 pos edge counter value LSB
ASR0N:                  .block  1               ; ASR0 neg edge counter value MSB
ASR0NL:                 .block  1               ; ASR0 neg edge counter value LSB
ASR1P:                  .block  1               ; ASR1 pos edge counter value MSB
ASR1PL:                 .block  1               ; ASR1 pos edge counter value LSB
ASR1N:                  .block  1               ; ASR1 neg edge counter value MSB
ASR1NL:                 .block  1               ; ASR1 neg edge counter value LSB
ASR2:                   .block  1               ; ASR2 edge counter value MSB
ASR2L:                  .block  1               ; ASR2 edge counter value LSB
ASR3:                   .block  1               ; ASR3 edge counter value MSB
ASR3L:                  .block  1               ; ASR3 edge counter value LSB
                        .block  1
                        .block  1
                        .block  1
OMODE:                  .block  1               ; Mode control Register
PORTA:                  .block  1               ; Port A Data Register
PORTAL:                 .block  1               ; Port A Latch
PORTB:                  .block  1               ; Port B Data Register
PBCS:                   .block  1               ; Port B Control Register
TAIT:                   .block  1               ; Timer ASR Control
LDOUT:                  .block  1               ; Latch DOUT
DOUT:                   .block  1               ; DOUT Data Register
DOM:                    .block  1               ; DOUT Control Register
PORTC:                  .block  1               ; Port C Data Register
PORTD_ASRIN:            .block  1               ; Port D Data Register / ASR Input Data
RAMST:                  .block  1               ; Built-in RAM status
SSD:                    .block  1               ; Serial Status Data Register
IRQL:                   .block  1               ; Interrupt Request Flag MSB
IRQLL:                  .block  1               ; Interrupt Request Flag LSB
IMASK:                  .block  1               ; Interrupt Request Mask MSB

                        .org    040h
ddr_value:              .block  1

                        .org    08000h

__RESET:                ; change to mode 2 (external)
                        ld  #02h, $OMODE            
                        di
                                
                        ; .byte stack pointer
                        ld  s, #01BFh               

                        ; initialise UART                        
                        ld  #18h, $SMRC_SIR         ; .byte SMRC cintrol reg to 0001 1000
                                
                        
                        ; initialise DDR value
                        ld  a, #055h
                        st  a, ddr_value

                        ld  #0E3h, $ASR0PL              ; ASR0 pos edge counter value LSB
                        ld  #3Fh,  $TAIT                 ; Timer ASR Control
                                                
                        ; turn LED on
                        ld  #00h, $DOM
                        ld  #00h, $DOUT                        
                        
loop2:                  
                        ; checksum ROM
                        jsr checksum
                        jsr putword

                        ; get DDR value, load into DDRA
                        ld  a, ddr_value                        
                        st  a, $DDRA
                        
                        ; load inverted DDR into DDRB
                        xor a, #0ffh
                        st  a, $DDRB
                        
                        ; reset test value
                        ld  a, #00h                 
loop1:                  
                        ; output test value on output bits of PORTA and PORTB
                        st  a, $PORTA
                        st  a, $PORTB
                        
                        ; output test value on PORTD
                        st  a, $PORTD_ASRIN

                        ; wait a bit for inputs to stabilise                        
                        ld  x, #0ff00h
delay1:                 inc x
                        bne delay1

                        ; read PORTA, check against test value
                        ld  b, $PORTA
                        cmp a, b
                        beq no_porta_error
                        bsr porta_error                        
no_porta_error:
                        ; read PORTB, check against test value
                        ld  b, $PORTB
                        cmp a, b
                        beq no_portb_error
                        bsr portb_error                        
no_portb_error:
                        ; read IRP, shift to bit 1, check against PORTD.1
                        push a
                        ld  b, $PBCS
                        and b, #20h
                        shr b
                        shr b
                        shr b
                        shr b
                        and a, #02h
                        cmp a, b
                        beq no_irp_error
                        bsr irp_error
no_irp_error            pull a
                        
                        ; read IS, check against PORTD.0
                        push a
                        ld  b, $PBCS
                        and b, #10h
                        shr b
                        shr b
                        shr b
                        shr b
                        and a, #01h
                        cmp a, b
                        beq no_is_error
                        bsr is_error
no_is_error:            pull a
                        
                        ; increment counter, loop if not back to 0
                        inc a
                        bne loop1
                        
                        ; invert DDR
                        ld  a, ddr_value
                        xor a, #0ffh
                        st  a, ddr_value
                        
                        ; toggle LED
                        ld  a, $DOUT
                        xor a, #0ffh
                        st  a, $DOUT

                        bra loop2

                        
checksum:               ld x, #08000h                 ; Load X with address of start of ROM
                        clr a                         ; Clear 16 bit checksum
                        clr b

checksum_loop:          add d, x + 00h                ; Add ROM 16 bit word to checksum
                        inc x                         ; Increment address
                        inc x                         ; Increment address

                        cmp x, #0000h                 ; Has the complete ROM been checksummed
                        bne checksum_loop             ; Jump back if not
                        ret

porta_error:            push a
                        ld y, #porta_err_str
                        bsr putstr
                        pull a
                        push a
                        xor a,$PORTA
                        bsr putbyte
                        pull a
                        ret

portb_error:            push a
                        ld y, #portb_err_str
                        bsr putstr
                        pull a
                        push a
                        xor a,$PORTB
                        bsr putbyte
                        pull a
                        ret
                        
is_error:               push a
                        ld y,#is_err_str
                        bsr putstr
                        pull a
                        ret
                        
irp_error:              push a
                        ld y,#irp_err_str
                        bsr putstr
                        pull a
                        ret

; error occurred, turn LED off
error:                  ld  #0ff, $DOUT
                        bra error


putc:                   ld  b, $SSD             ; load serial status data reg into b
                        and b, #20h             ; mask (bit 5)  0010 0000
                        beq putc                ; loop until bit 6 .byte
                        st  a, $SIDR_SODR       ; store character from a into SODR
                        ret                     

putstr_loop:            bsr  putc
putstr:                 ld   a, [y]             ; load first char of string pointed to by y 
                        cmpz a                  ; is it the null terminator
                        bne  putstr_loop
                        ret

putnibble:              push d
                        ld   y, #hex_code
                        and  a, #0Fh
                        add  y, a
                        ld   a, [y]
                        bsr  putc
                        pull d
                        ret
                        
putbyte:                bsr  putnibble                  
                        shr  a
                        shr  a
                        shr  a
                        shr  a
                        bra  putnibble
                        
putword:                bsr  putbyte
                        mov  b, a
                        bra  putbyte

porta_err_str           .text "\n\rPORTA error: "
                        .db 0
portb_err_str           .text "\n\rPORTB error: "
                        .db 0
is_err_str              .text "\n\rIS error"
                        .db 0
irp_err_str             .text "\n\rIRP error"
                        .db 0

hex_code                .text "0123456789ABCDEF"

                        .org  09000h
                        .byte 220, 130, 245, 132, 187, 46, 31, 30, 198, 120, 152, 164, 201, 160, 118, 0
                        .byte 126, 97, 137, 76, 115, 233, 206, 236, 240, 37, 237, 211, 184, 93, 173, 208
                        .byte 176, 67, 148, 236, 231, 178, 101, 42, 107, 65, 235, 195, 41, 124, 63, 109
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                        .byte 248, 8, 238, 192, 182, 102, 131, 111, 142, 58, 146, 234, 48, 72, 222, 195                        


                        .org 0FFDAh
checkword:              .dw  00000h

                        .org 0FFDEh
                        
IV0:                    .dw 0FFFFh              ; External interrupt 0
IV1:                    .dw 0FFFFh              ; External interrupt 1
IV2:                    .dw 0FFFFh              ; External interrupt 2
IV3:                    .dw 0FFFFh              ; External interrupt 3
IV4:                    .dw 0FFFFh              ; External interrupt 4
IV5:                    .dw 0FFFFh              ; External interrupt 5
IV6:                    .dw 0FFFFh              ; External interrupt 6
IV7:                    .dw 0FFFFh              ; External interrupt 7
IV8:                    .dw 0FFFFh              ; External interrupt 8
IV9:                    .dw 0FFFFh              ; External interrupt 9
IVa:                    .dw 0FFFFh              ; External interrupt a
IVb:                    .dw 0FFFFh              ; External interrupt b
IVc:                    .dw 0FFFFh              ; External interrupt c
IVd:                    .dw 0FFFFh              ; External interrupt d
IVe:                    .dw 0FFFFh              ; External interrupt e
IVf:                    .dw 0FFFFh              ; External interrupt f
RESET                   .dw __RESET

                        .end
